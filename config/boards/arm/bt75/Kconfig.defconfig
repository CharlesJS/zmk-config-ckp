## config/boards/arm/bt75/Kconfig.defconfig
```kconfig
# Copyright (c) 2021 Polarity Works
# SPDX-License-Identifier: MIT

if USB

config USB_NRFX
	default y

config USB_DEVICE_STACK
	default y

endif # USB

config BT_CTLR
	default BT

config ZMK_BLE
	default y

config ZMK_USB
	default y

config ZMK_BATTERY_VOLTAGE_DIVIDER
	default y

	config ZMK_KEYBOARD_NAME
		default "DasKlavier"

config BT75_BOOTMODE
	bool
	imply RETAINED_MEM
	imply RETENTION
	imply RETENTION_BOOT_MODE
```
